## config/west.yml
```yaml
manifest:
  remotes:
    - name: zmkfirmware
      url-base: https://github.com/zmkfirmware
    # dongle_display
    - name: englmaxi
      url-base: https://github.com/englmaxi
    # nice_oled - nice_epaper - dongle_display!view - oled Adapter
    - name: mctechnology17
      url-base: https://github.com/mctechnology17
    - name: petejohanson
      url-base: https://github.com/petejohanson
    - name: gpeye
      url-base: https://github.com/GPeye
    - name: kevinpastor
      url-base: https://github.com/kevinpastor
    - name: m165437
      url-base: https://github.com/M165437
    - name: s6t
      url-base: https://github.com/s6t
    - name: infely
      url-base: https://github.com/infely
      
  projects:
    - name: zmk
      remote: zmkfirmware
      revision: main
      import: app/west.yml
    # dongle_display
    - name: zmk-dongle-display
      remote: englmaxi
      revision: main
    # nice_oled - nice_epaper
    - name: zmk-nice-oled
      remote: mctechnology17
      revision: main
    # dongle_display!view
    - name: zmk-dongle-display-view
      remote: mctechnology17
      revision: main
    # oled Adapter
    - name: zmk-oled-adapter
      remote: mctechnology17
      revision: main
  self:
    path: config
```
